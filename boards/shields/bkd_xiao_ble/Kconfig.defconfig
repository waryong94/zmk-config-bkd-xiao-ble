## boards/shields/bkd_xiao_ble/Kconfig.defconfig
```kconfig
# Copyright (c) 2022 The ZMK Contributors
# SPDX-License-Identifier: MIT

if SHIELD_BKD_XIAO_BLE_LEFT

config ZMK_KEYBOARD_NAME
    default "bkd xiao"

config ZMK_SPLIT_ROLE_CENTRAL
    default y

endif

if SHIELD_BKD_XIAO_BLE_LEFT || SHIELD_BKD_XIAO_BLE_RIGHT

config ZMK_SPLIT
    default y

endif
```

## boards/shields/bkd_xiao_ble/Kconfig.shield
```kconfig
# Copyright (c) 2024 The ZMK Contributors
# SPDX-License-Identifier: MIT

config SHIELD_BKD_XIAO_BLE_LEFT
    def_bool $(shields_list_contains,bkd_xiao_ble_left)

config SHIELD_BKD_XIAO_BLE_RIGHT
    def_bool $(shields_list_contains,bkd_xiao_ble_right)
```
